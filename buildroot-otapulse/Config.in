## buildroot-otapulse/Config.in
```kconfig
# OTA-Pulse BR2_EXTERNAL Configuration

menu "OTA-Pulse"
	source "$BR2_EXTERNAL_OTAPULSE_PATH/package/otapulse/Config.in"
	source "$BR2_EXTERNAL_OTAPULSE_PATH/package/socmond/Config.in"
endmenu
```

## buildroot-otapulse/configs/otapulse_rpi4_defconfig
```kconfig
# OTA-Pulse Configuration for Raspberry Pi 4
#
# Complete configuration for Raspberry Pi 4 with OTA-Pulse support.
# Includes U-Boot for proper A/B boot slot switching.
#
# Usage:
#   cd buildroot
#   make BR2_EXTERNAL=/path/to/OTA-Pulse/buildroot-otapulse otapulse_rpi4_defconfig
#   make menuconfig  # Configure OTA server URL and verification key
#   make
#

# Architecture
BR2_aarch64=y
BR2_cortex_a72=y

# Toolchain
BR2_TOOLCHAIN_BUILDROOT_GLIBC=y
BR2_TOOLCHAIN_BUILDROOT_CXX=y

# System configuration
BR2_TARGET_GENERIC_HOSTNAME="otapulse-rpi4"
BR2_TARGET_GENERIC_ISSUE="OTA-Pulse Raspberry Pi 4"
BR2_SYSTEM_DHCP="eth0"
BR2_ROOTFS_POST_BUILD_SCRIPT="$(BR2_EXTERNAL_OTAPULSE_PATH)/board/otapulse/post-build.sh"
BR2_ROOTFS_POST_IMAGE_SCRIPT="$(BR2_EXTERNAL_OTAPULSE_PATH)/board/otapulse/post-image.sh"

# Filesystem
BR2_TARGET_ROOTFS_EXT2=y
BR2_TARGET_ROOTFS_EXT2_4=y
BR2_TARGET_ROOTFS_EXT2_SIZE="1G"

# Kernel
BR2_LINUX_KERNEL=y
BR2_LINUX_KERNEL_CUSTOM_TARBALL=y
BR2_LINUX_KERNEL_CUSTOM_TARBALL_LOCATION="$(call github,raspberrypi,linux,stable_20231030)/linux-stable_20231030.tar.gz"
BR2_LINUX_KERNEL_DEFCONFIG="bcm2711"
BR2_LINUX_KERNEL_IMAGE=y
BR2_LINUX_KERNEL_DTS_SUPPORT=y
BR2_LINUX_KERNEL_INTREE_DTS_NAME="broadcom/bcm2711-rpi-4-b"
BR2_LINUX_KERNEL_NEEDS_HOST_OPENSSL=y

# Bootloader - U-Boot for A/B support
BR2_TARGET_UBOOT=y
BR2_TARGET_UBOOT_BUILD_SYSTEM_KCONFIG=y
BR2_TARGET_UBOOT_CUSTOM_VERSION=y
BR2_TARGET_UBOOT_CUSTOM_VERSION_VALUE="2023.10"
BR2_TARGET_UBOOT_BOARD_DEFCONFIG="rpi_4"
BR2_TARGET_UBOOT_FORMAT_BIN=y
BR2_PACKAGE_UBOOT_TOOLS=y
BR2_PACKAGE_UBOOT_TOOLS_FWPRINTENV=y

# Raspberry Pi firmware
BR2_PACKAGE_RPI_FIRMWARE=y
BR2_PACKAGE_RPI_FIRMWARE_VARIANT_PI4=y

# Init system
BR2_INIT_SYSTEMD=y
BR2_PACKAGE_SYSTEMD_NETWORKD=y
BR2_PACKAGE_SYSTEMD_RESOLVED=y

# Required packages for OTA
BR2_PACKAGE_CA_CERTIFICATES=y
BR2_PACKAGE_OPENSSL=y
BR2_PACKAGE_UTIL_LINUX=y
BR2_PACKAGE_UTIL_LINUX_LIBBLKID=y
BR2_PACKAGE_E2FSPROGS=y
BR2_PACKAGE_DOSFSTOOLS=y
BR2_PACKAGE_GPT_FDISK=y
BR2_PACKAGE_GPT_FDISK_SGDISK=y
BR2_PACKAGE_DBUS=y

# Network tools
BR2_PACKAGE_DROPBEAR=y
BR2_PACKAGE_CURL=y
BR2_PACKAGE_WIRELESS_TOOLS=y
BR2_PACKAGE_WPA_SUPPLICANT=y

# OTA-Pulse Package
BR2_PACKAGE_OTAPULSE=y
# BR2_PACKAGE_OTAPULSE_SERVER_URL must be set in menuconfig
# BR2_PACKAGE_OTAPULSE_VERIFY_KEY must be set in menuconfig
BR2_PACKAGE_OTAPULSE_DEVICE_TYPE="raspberrypi4"
BR2_PACKAGE_OTAPULSE_UPDATE_POLL_INTERVAL=1800
BR2_PACKAGE_OTAPULSE_INVENTORY_POLL_INTERVAL=28800
BR2_PACKAGE_OTAPULSE_RETRY_POLL_INTERVAL=300
BR2_PACKAGE_OTAPULSE_PARTITION_STATIC=y
BR2_PACKAGE_OTAPULSE_ROOTFS_SIZE="2G"
BR2_PACKAGE_OTAPULSE_DATA_SIZE="512M"
BR2_PACKAGE_OTAPULSE_BOOT_UBOOT_ENV=y
BR2_PACKAGE_OTAPULSE_UBOOT_ENV_CONFIG="/etc/fw_env.config"
BR2_PACKAGE_OTAPULSE_DBUS=y
BR2_PACKAGE_OTAPULSE_INVENTORY=y
BR2_PACKAGE_OTAPULSE_STATE_SCRIPTS=y
BR2_PACKAGE_OTAPULSE_UPDATE_MODULES=y
BR2_PACKAGE_OTAPULSE_WATCHDOG=y
BR2_PACKAGE_OTAPULSE_SYSTEMD=y

# SoC Monitoring (socmond, soc-ctl)
BR2_PACKAGE_SOCMOND=y

# Genimage configuration
BR2_PACKAGE_OTAPULSE_GENIMAGE_CFG="$(BR2_EXTERNAL_OTAPULSE_PATH)/board/otapulse/genimage-rpi.cfg"

# Host tools
BR2_PACKAGE_HOST_DOSFSTOOLS=y
BR2_PACKAGE_HOST_E2FSPROGS=y
BR2_PACKAGE_HOST_GENIMAGE=y
BR2_PACKAGE_HOST_MTOOLS=y
BR2_PACKAGE_HOST_UBOOT_TOOLS=y
```

## buildroot-otapulse/package/frp/Config.in
```kconfig
comment "frp needs an aarch64, arm, x86_64 or i386 target"
	depends on !(BR2_aarch64 || BR2_arm || BR2_x86_64 || BR2_i386)

config BR2_PACKAGE_FRP
	bool "frp (frpc client)"
	depends on BR2_aarch64 || BR2_arm || BR2_x86_64 || BR2_i386
	help
	  frp (Fast Reverse Proxy) client (frpc) — a NAT-traversal reverse
	  tunnel client. OTA-Pulse's soc-ota-tunneld (BR2_PACKAGE_OTAPULSE_
	  REMOTE_SSH) supervises frpc on-device to establish the Remote SSH
	  terminal feature's reverse tunnel to the OTA-Pulse gateway.

	  Only the frpc (client) binary is installed; frps (server) runs on
	  the OTA-Pulse gateway, not on the device.

	  Ships as a pre-built static Go binary — no compilation, mirrors
	  meta-otapulse's recipes-connectivity/frp/frp_0.69.0.bb on the
	  Yocto side.

	  https://github.com/fatedier/frp
```

## buildroot-otapulse/package/memfault/Config.in
```kconfig
comment "memfault requires systemd (BR2_INIT_SYSTEMD)"
	depends on !BR2_INIT_SYSTEMD

config BR2_PACKAGE_MEMFAULT
	bool "memfault"
	depends on BR2_INIT_SYSTEMD
	select BR2_PACKAGE_CA_CERTIFICATES
	select BR2_PACKAGE_LIBCURL
	select BR2_PACKAGE_LIBCURL_CURL
	select BR2_PACKAGE_JQ
	help
	  SoC Monitoring daemon and CLI tools for embedded Linux devices.
	  Provides telemetry collection, crash capture, coredump handling,
	  device provisioning, and system health monitoring.

	  Installs:
	  - memfaultd: monitoring daemon (metrics, heartbeat, coredumps)
	  - memfault-watchdog: hardware watchdog monitor
	  - soc-ctl: device control CLI (config, provision, status)
	  - soc-deregister: device deregistration utility
	  - show-version: firmware version display

	  Requires systemd as the init system (BR2_INIT_SYSTEMD=y).

if BR2_PACKAGE_MEMFAULT

config BR2_PACKAGE_MEMFAULT_DASHBOARD
	bool "Local web dashboard"
	select BR2_PACKAGE_PYTHON3
	help
	  Install the local web dashboard (soc-dashboard) that provides
	  real-time device status via a browser interface on port 8080.

	  Requires Python 3. Adds ~5MB to the image.
	  The dashboard service is disabled by default and must be
	  enabled manually with: soc-ctl dashboard enable

endif # BR2_PACKAGE_MEMFAULT
```
