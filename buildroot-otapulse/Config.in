## buildroot-otapulse/package/otapulse/Config.in
```kconfig
comment "otapulse requires systemd (BR2_INIT_SYSTEMD)"
	depends on !BR2_INIT_SYSTEMD

config BR2_PACKAGE_OTAPULSE
	bool "otapulse"
	depends on BR2_INIT_SYSTEMD
	depends on BR2_PACKAGE_HOST_GO_TARGET_ARCH_SUPPORTS
	depends on BR2_PACKAGE_HOST_GO_TARGET_CGO_LINKING_SUPPORTS
	depends on BR2_TOOLCHAIN_HAS_THREADS
	select BR2_PACKAGE_HOST_GO
	select BR2_PACKAGE_HOST_MENDER_ARTIFACT
	select BR2_PACKAGE_OPENSSL
	select BR2_PACKAGE_CA_CERTIFICATES
	select BR2_PACKAGE_UTIL_LINUX
	select BR2_PACKAGE_UTIL_LINUX_LIBBLKID
	select BR2_PACKAGE_E2FSPROGS
	select BR2_PACKAGE_DOSFSTOOLS
	select BR2_PACKAGE_GPTFDISK
	select BR2_PACKAGE_XZ
	select BR2_PACKAGE_SOCMOND
	help
	  OTA-Pulse is a robust over-the-air (OTA) update solution for
	  embedded Linux devices. It provides atomic A/B partition updates
	  with automatic rollback capability.

	  Requires systemd as the init system (BR2_INIT_SYSTEMD=y).
	  The OTA agent relies on systemd for service ordering,
	  partition setup sequencing, and automatic restart.

	  Features:
	  - Atomic A/B rootfs updates
	  - Cryptographic signature verification (mandatory)
	  - Automatic rollback on failure
	  - State script hooks for custom actions
	  - D-Bus API for programmatic control

	  https://github.com/AkhileshNS/OTA-Pulse

if BR2_PACKAGE_OTAPULSE

comment "--- Server Configuration (Required) ---"

config BR2_PACKAGE_OTAPULSE_SERVER_URL
	string "OTA Server URL"
	help
	  The URL of the OTA management server.
	  Example: https://ota.example.com

	  This is REQUIRED. The build will fail if not set.

config BR2_PACKAGE_OTAPULSE_TENANT_TOKEN
	string "Tenant Token"
	default ""
	help
	  The tenant token for multi-tenant server deployments.
	  Leave empty if not using multi-tenancy.

comment "--- Security Configuration (Mandatory) ---"

config BR2_PACKAGE_OTAPULSE_VERIFY_KEY
	string "Artifact Verification Public Key Path"
	help
	  Path to the RSA or ECDSA public key file used to verify
	  firmware artifact signatures.

	  This is REQUIRED. Signature verification cannot be disabled.

	  The key file will be copied to /etc/otapulse/keys/ on the target.

	  Generate a key pair with:
	    openssl genpkey -algorithm RSA -out private.pem -pkeyopt rsa_keygen_bits:4096
	    openssl rsa -pubout -in private.pem -out public.pem

	  Or for ECDSA:
	    openssl ecparam -genkey -name secp384r1 -out private.pem
	    openssl ec -in private.pem -pubout -out public.pem

config BR2_PACKAGE_OTAPULSE_VERIFY_KEY_SECONDARY
	string "Secondary Verification Key (Optional)"
	default ""
	help
	  Path to a secondary public key for key rotation scenarios.
	  During key rotation, both old and new keys can be trusted.
	  Leave empty if not needed.

config BR2_PACKAGE_OTAPULSE_SIGNING_KEY
	string "Artifact Signing Private Key Path (build host)"
	help
	  Path to the RSA or ECDSA private key file used to sign firmware
	  artifacts during the post-image build step.

	  This key is used by the host-mender-artifact tool at build time
	  and is NEVER embedded in the firmware image.

	  The build will fail if this key is not set or the file does not exist.

	  Generate a key pair with:
	    openssl genpkey -algorithm RSA -out keys/otapulse-private.pem \
	        -pkeyopt rsa_keygen_bits:4096
	    openssl rsa -pubout -in keys/otapulse-private.pem \
	        -out keys/otapulse-public.pem

	  Keep the private key out of version control (add to .gitignore).

comment "--- Device Configuration ---"

config BR2_PACKAGE_OTAPULSE_DEVICE_TYPE
	string "Device Type Identifier"
	default "generic-arm"
	help
	  A unique identifier for this device type/platform.
	  Used by the OTA server to target specific device groups.

	  Examples: imx8mp-evk, rpi4, rockchip-rk3588

comment "--- Polling Configuration ---"

config BR2_PACKAGE_OTAPULSE_UPDATE_POLL_INTERVAL
	int "Update Poll Interval (seconds)"
	default 1800
	help
	  How often the device checks for new updates.
	  Default: 1800 (30 minutes)

	  Lower values increase server load but provide faster updates.
	  Minimum recommended: 300 (5 minutes)

config BR2_PACKAGE_OTAPULSE_INVENTORY_POLL_INTERVAL
	int "Inventory Poll Interval (seconds)"
	default 28800
	help
	  How often the device reports its inventory/telemetry.
	  Default: 28800 (8 hours)

config BR2_PACKAGE_OTAPULSE_RETRY_POLL_INTERVAL
	int "Retry Poll Interval (seconds)"
	default 300
	help
	  How long to wait before retrying after a failed operation.
	  Default: 300 (5 minutes)

comment "--- Partition Configuration ---"

choice
	prompt "Partition Mode"
	default BR2_PACKAGE_OTAPULSE_PARTITION_DYNAMIC
	help
	  Select how A/B partitions are configured.

config BR2_PACKAGE_OTAPULSE_PARTITION_DYNAMIC
	bool "Dynamic (first-boot setup)"
	help
	  A/B partitions are created on first boot.
	  Smaller initial image, requires first-boot script.
	  Recommended for most use cases.

config BR2_PACKAGE_OTAPULSE_PARTITION_STATIC
	bool "Static (pre-allocated)"
	help
	  A/B partitions are pre-created in the image.
	  Larger initial image, no first-boot setup needed.
	  Required for systems without resize capability.

endchoice

config BR2_PACKAGE_OTAPULSE_ROOTFS_PART_A
	string "RootfsPartA device path"
	default "/dev/disk/by-partlabel/rootfs_a"
	help
	  Block device path for the rootfs A partition.
	  The OTA agent uses this to determine which partition is active
	  and which is inactive for A/B updates.

	  Use /dev/disk/by-partlabel/rootfs_a for systems with udev and
	  GPT partition labels (production hardware).
	  Use /dev/vda2 for QEMU VirtIO testing.
	  Use /dev/mmcblk0p2 for eMMC-based boards.

config BR2_PACKAGE_OTAPULSE_ROOTFS_PART_B
	string "RootfsPartB device path"
	default "/dev/disk/by-partlabel/rootfs_b"
	help
	  Block device path for the rootfs B partition.
	  The OTA agent writes new firmware here during an update.

	  Use /dev/disk/by-partlabel/rootfs_b for systems with udev and
	  GPT partition labels (production hardware).
	  Use /dev/vda3 for QEMU VirtIO testing.
	  Use /dev/mmcblk0p3 for eMMC-based boards.

config BR2_PACKAGE_OTAPULSE_ROOTFS_SIZE
	string "Root Filesystem Size"
	default "1G"
	help
	  Size of each rootfs partition (A and B).
	  Use suffixes: M for megabytes, G for gigabytes.

	  Examples: 512M, 1G, 2G

	  Must be larger than the actual rootfs content.
	  For large images (Qt, multimedia), use 2G or more.

config BR2_PACKAGE_OTAPULSE_DATA_SIZE
	string "Data Partition Size"
	default "512M"
	help
	  Size of the persistent data partition.
	  This partition survives OTA updates.

	  Stores: credentials, SSH keys, application data.

comment "--- Boot Environment ---"

choice
	prompt "Boot Slot Switching Method"
	default BR2_PACKAGE_OTAPULSE_BOOT_UBOOT_ENV
	help
	  Select how the bootloader determines which partition to boot.

config BR2_PACKAGE_OTAPULSE_BOOT_UBOOT_ENV
	bool "U-Boot Environment"
	select BR2_PACKAGE_UBOOT_TOOLS
	help
	  Use U-Boot environment variables (fw_setenv/fw_printenv).
	  Most common method, works with most ARM SoCs.
	  Requires u-boot-fw-utils package.

config BR2_PACKAGE_OTAPULSE_BOOT_GRUB
	bool "GRUB Environment"
	depends on BR2_TARGET_GRUB2
	help
	  Use GRUB environment block for x86/x86_64 systems.
	  Requires grub-editenv utility.

config BR2_PACKAGE_OTAPULSE_BOOT_FILE
	bool "File-based (fallback)"
	help
	  Use a file on the data partition to track boot slot.
	  Only use if U-Boot env is not available.
	  Warning: Less reliable after rollback scenarios.

endchoice

if BR2_PACKAGE_OTAPULSE_BOOT_UBOOT_ENV

config BR2_PACKAGE_OTAPULSE_UBOOT_ENV_CONFIG
	string "U-Boot Environment Config File"
	default "/etc/fw_env.config"
	help
	  Path to the U-Boot environment configuration file.
	  This file tells fw_setenv where the environment is stored.

endif

comment "--- Optional Features ---"

config BR2_PACKAGE_OTAPULSE_DBUS
	bool "D-Bus API support"
	default y
	select BR2_PACKAGE_DBUS
	select BR2_PACKAGE_LIBGLIB2
	help
	  Enable D-Bus API for programmatic control of the OTA agent.

	  Allows other applications to:
	  - Trigger updates programmatically
	  - Query update status
	  - Control update flow (pause, resume, commit)

config BR2_PACKAGE_OTAPULSE_INVENTORY
	bool "Inventory/Telemetry collection"
	default y
	help
	  Enable device inventory and telemetry reporting.

	  Collects: CPU info, memory, disk usage, network info, etc.
	  Reported to the OTA server for fleet management.

config BR2_PACKAGE_OTAPULSE_STATE_SCRIPTS
	bool "Install example state scripts"
	default y
	help
	  Install example state scripts that run during OTA lifecycle.

	  Scripts run at: Download, Install, Reboot, Commit stages.
	  Useful for stopping services, backing up data, etc.

config BR2_PACKAGE_OTAPULSE_UPDATE_MODULES
	bool "Install update modules"
	default y
	help
	  Install update modules for different artifact types.

	  Includes: single-file, directory, docker, deb, rpm modules.
	  Allows updating more than just the rootfs.

config BR2_PACKAGE_OTAPULSE_WATCHDOG
	bool "Watchdog support"
	default y
	select BR2_PACKAGE_BUSYBOX_SHOW_OTHERS
	help
	  Enable hardware watchdog integration.

	  Automatically reboots the device if the update process hangs.
	  Provides additional safety during OTA operations.

comment "--- Remote SSH Tunnel (soc-ota-tunneld) ---"

config BR2_PACKAGE_OTAPULSE_REMOTE_SSH
	bool "Remote SSH tunnel (soc-ota-tunneld)"
	default y
	depends on BR2_aarch64 || BR2_arm || BR2_x86_64 || BR2_i386
	select BR2_PACKAGE_FRP
	select BR2_PACKAGE_SUDO
	help
	  Build and install soc-ota-tunneld, the reverse-SSH NAT-traversal
	  tunnel supervisor daemon that powers the Remote SSH terminal
	  feature (TODO-002). It supervises the frpc client (BR2_PACKAGE_FRP)
	  to establish a persistent reverse TCP tunnel from this device to
	  the OTA-Pulse gateway. Mirrors meta-otapulse's recipes-core/
	  soc-ota-tunnel/soc-ota-tunneld_1.0.0.bb on the Yocto side.

	  Set BR2_PACKAGE_OTAPULSE_TUNNEL_SERVER_ADDR to the frps gateway's
	  hostname/IP for the tunnel to actually connect.

	  NOTE (BUG-208): even with this enabled, the tunnel will not come up
	  until a per-device tunnel credential is minted to
	  /data/frp/credential — on Buildroot images this currently requires
	  a manual/test-harness provisioning step, since otapulse-auto-
	  provision (which mints it on Yocto hardware boards) is not yet
	  packaged for this board type.

	  NOTE (BUG-215): this option also selects BR2_PACKAGE_SUDO and
	  installs the shell-access layer (support user + curated NOPASSWD
	  sudoers allowlist + gateway authorized key) that the gateway's
	  Standard SSH tier needs to actually log in through the tunnel —
	  mirrors meta-otapulse's recipes-core/soc-shell-access/
	  soc-shell-access_1.0.0.bb. Without it the gateway attaches the
	  session WebSocket but the SSH handshake into the device fails
	  (WS close 1011).

if BR2_PACKAGE_OTAPULSE_REMOTE_SSH

config BR2_PACKAGE_OTAPULSE_TUNNEL_SERVER_ADDR
	string "Tunnel (frps) Server Address"
	default ""
	help
	  Hostname or IP of the frps gateway that soc-ota-tunneld's
	  supervised frpc client connects to.

	  Example: 192.168.0.123 (LAN) or staging.ota-pulse.com

config BR2_PACKAGE_OTAPULSE_TUNNEL_SERVER_PORT
	int "Tunnel (frps) Server Port"
	default 7000
	help
	  TCP port the frps gateway listens on for frpc connections.

endif # BR2_PACKAGE_OTAPULSE_REMOTE_SSH

comment "--- Development / Testing ---"

config BR2_PACKAGE_OTAPULSE_DEV_SSH_KEY
	string "Dev SSH Authorized Keys File"
	default ""
	help
	  Path to an SSH authorized_keys file to install into
	  /root/.ssh/authorized_keys on the target.

	  This is for development and QEMU testing only.
	  Leave empty for production builds.

	  Example: $(BR2_EXTERNAL_OTAPULSE_PATH)/keys/dev-authorized_keys

comment "--- Systemd Service Configuration ---"

config BR2_PACKAGE_OTAPULSE_SYSTEMD
	bool "Install systemd service"
	default y
	help
	  Install the systemd service files for automatic startup.
	  This installs service units for the OTA agent, first-boot
	  partition setup, and auto-provisioning.

endif # BR2_PACKAGE_OTAPULSE
```

## buildroot-otapulse/package/socmond/Config.in
```kconfig
comment "socmond requires systemd (BR2_INIT_SYSTEMD)"
	depends on !BR2_INIT_SYSTEMD

config BR2_PACKAGE_SOCMOND
	bool "socmond"
	depends on BR2_INIT_SYSTEMD
	select BR2_PACKAGE_CA_CERTIFICATES
	select BR2_PACKAGE_LIBCURL
	select BR2_PACKAGE_LIBCURL_CURL
	select BR2_PACKAGE_JQ
	help
	  SoC Monitoring daemon and CLI tools for embedded Linux devices.
	  Provides telemetry collection, crash capture, coredump handling,
	  device provisioning, and system health monitoring.

	  Installs:
	  - socmond: monitoring daemon (metrics, heartbeat, coredumps)
	  - socmond-watchdog: hardware watchdog monitor
	  - soc-ctl: device control CLI (config, provision, status)
	  - soc-deregister: device deregistration utility
	  - show-version: firmware version display

	  Requires systemd as the init system (BR2_INIT_SYSTEMD=y).

if BR2_PACKAGE_SOCMOND

comment "--- Server Provisioning (Optional) ---"

config BR2_PACKAGE_SOCMOND_SERVER_URL
	string "SoC Monitoring Server URL"
	default ""
	help
	  Base URL of the SoC Monitoring backend (e.g. http://192.168.0.123:8000),
	  baked into /etc/socmond/config.json's server.base_url at build time.

	  Leave empty to keep the shipped config.json default and provision
	  socmond at runtime instead — the normal path for boards with a
	  persistent (non-snapshot) rootfs.

config BR2_PACKAGE_SOCMOND_PROVISIONING_TOKEN
	string "SoC Monitoring Provisioning Token"
	default ""
	help
	  An spt_... provisioning token (see socMonitoring's
	  POST /api/provisioning-tokens) baked into config.json's
	  auth.provisioning_token at build time.

	  Required for devices with an ephemeral/snapshot-mode disk (e.g. QEMU
	  in snapshot mode), where a runtime SSH-based credential push cannot
	  survive the next VM restart.

config BR2_PACKAGE_SOCMOND_DASHBOARD
	bool "Local web dashboard"
	select BR2_PACKAGE_PYTHON3
	help
	  Install the local web dashboard (soc-dashboard) that provides
	  real-time device status via a browser interface on port 8080.

	  Requires Python 3. Adds ~5MB to the image.
	  The dashboard service is disabled by default and must be
	  enabled manually with: soc-ctl dashboard enable

endif # BR2_PACKAGE_SOCMOND
```
